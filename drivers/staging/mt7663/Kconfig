## drivers/staging/mt7663/Kconfig
```kconfig
config MT7663
        tristate "mediatek MT7663 Wireless LAN NIC driver"
        depends on WLAN && USB && CFG80211
        help
	   MT7663 USB WIFI
```

## drivers/staging/rtl88x2cu/Kconfig
```kconfig
config RTL8822BU
	tristate "Realtek 8822BU USB WiFi"
	depends on USB
	help
	 Help message of RTL8822CU

config RTL8822CU
	tristate "Realtek 8822CU USB WiFi"
	depends on USB
	help
	  Help message of RTL8822CU
```
